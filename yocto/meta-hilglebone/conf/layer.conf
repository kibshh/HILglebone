## yocto/meta-hilglebone/conf/layer.conf
```bitbake
# meta-hilglebone layer configuration
#
# This file is what makes a directory a "Yocto layer" in BitBake's eyes.
# Without it, BitBake will refuse to recognize the directory even if it
# contains recipes.

# Add this layer's directory to BBPATH so files like classes/conf can be
# resolved relative to it.
BBPATH .= ":${LAYERDIR}"

# Glob patterns BitBake uses to discover recipes (.bb) and recipe extensions
# (.bbappend) inside this layer. The depth-2 wildcard matches the standard
# layout: recipes-<category>/<recipe-name>/<file>.bb
BBFILES += "${LAYERDIR}/recipes-*/*/*.bb \
            ${LAYERDIR}/recipes-*/*/*.bbappend"

# Register this layer's name with BitBake.
BBFILE_COLLECTIONS += "meta-hilglebone"

# Pattern that identifies which recipe paths belong to this collection.
# Anything under LAYERDIR is ours.
BBFILE_PATTERN_meta-hilglebone = "^${LAYERDIR}/"

# Layer priority. Higher numbers win when two layers provide the same recipe.
# Default Poky layers are at 5; we sit at 10 so our overrides take precedence
# without being aggressive.
BBFILE_PRIORITY_meta-hilglebone = "10"

# We depend on the core layer (Poky's meta/) being present.
LAYERDEPENDS_meta-hilglebone = "core"

# Yocto release branches this layer is known to work with.
LAYERSERIES_COMPAT_meta-hilglebone = "kirkstone scarthgap"
```
